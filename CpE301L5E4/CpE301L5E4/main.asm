;
; L5E4.asm
;
; Created: 2/26/2016 5:49:33 PM
; Author : jmsikorski
;


	SBI		DDRB, 5
	SBI		DDRB, 6
	LDI		R19, 1<<6
	OUT		PORTB, R19
ON: 	
	LDI		R19, 0<<6
	OUT		PORTB, R19
	LDI		R20, 0x7A
	STS		OCR1AH, R20
	LDI		R20, 0x14
	STS 	OCR1AL,R20		;OCR1A = 15,624
	RJMP	SET1
OFF:
	LDI		R19, 1<<6
	OUT		PORTB, R19
	LDI		R20, 0x1E
	STS		OCR1AH, R20
	LDI		R20, 0x85
	STS		OCR1AL, R20
SET1:
	LDI 	R20, 0x0D 
	STS 	TCCR1B, R20		;CTC, 256 prescaler, set on match
	LDI		R20, 0x40
	STS		TCCR1A, R20
L1: 
	IN		R20, TIFR1
	SBRS 	R20,OCF1A	;skip next instruction if OCF1A = 1
	RJMP 	L1
	LDI		R16,1<<OCF1A 
	STS 	TIFR1,R16	;clear OCF1A
	IN		R16, PINB
	ANDI	R16, 1<<5
	CPI		R16, 0
	BRNE	ON				
	RJMP	OFF